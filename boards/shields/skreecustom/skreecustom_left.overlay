#include "skreecustom.dtsi"

//&kscan0 {
//    col-gpios           // SR 0-7
//        = <&shifter 0 GPIO_ACTIVE_HIGH>
//        , <&shifter 1 GPIO_ACTIVE_HIGH>
//        , <&shifter 2 GPIO_ACTIVE_HIGH>
//        , <&shifter 3 GPIO_ACTIVE_HIGH>
//        , <&shifter 4 GPIO_ACTIVE_HIGH>
//        , <&shifter 5 GPIO_ACTIVE_HIGH>
//      , <&shifter 6 GPIO_ACTIVE_HIGH>
//      , <&shifter 7 GPIO_ACTIVE_HIGH>
//        ;
//};

&kscan0 {
    col-gpios           // Col1-7 1.03 1.14 1.05 1.13 1.07 1.12 0.16 
        = <&gpio1 3 GPIO_ACTIVE_HIGH> 
        , <&gpio1 14 GPIO_ACTIVE_HIGH>
        , <&gpio1 5 GPIO_ACTIVE_HIGH>
        , <&gpio1 13 GPIO_ACTIVE_HIGH> 
        , <&gpio1 7 GPIO_ACTIVE_HIGH> 
        , <&gpio1 12 GPIO_ACTIVE_HIGH> 
//      , <&gpio0 16 GPIO_ACTIVE_HIGH> 
        ;
};